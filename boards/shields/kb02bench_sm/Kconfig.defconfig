## boards/shields/kb02bench_sm/Kconfig.defconfig
```kconfig
if SHIELD_KB02BENCH_SM

config ZMK_KEYBOARD_NAME
    default "kb02 bench SM"

endif
```

## boards/shields/kb02bench_xiao/Kconfig.defconfig
```kconfig
if SHIELD_KB02BENCH_XIAO

config ZMK_KEYBOARD_NAME
    default "kb02 bench XIAO"

endif
```

## boards/shields/kb02bench_xiao/Kconfig.shield
```kconfig
config SHIELD_KB02BENCH_XIAO
    def_bool $(shields_list_contains,kb02bench_xiao)
```

## boards/shields/kb02test/Kconfig.shield
```kconfig
config SHIELD_KB02TEST_LEFT
    def_bool $(shields_list_contains,kb02test_left)

config SHIELD_KB02TEST_RIGHT
    def_bool $(shields_list_contains,kb02test_right)
```

## config/west.yml
```yaml
manifest:
  remotes:
    - name: zmkfirmware
      url-base: https://github.com/zmkfirmware
    - name: infused-kim
      url-base: https://github.com/infused-kim

  projects:
    #
    # ZMK 本体 — どちらか一方だけ有効にする
    #

    # (1) まずはこれ：infused-kim の fork。PS/2 ドライバモジュールと動く組み合わせとして既知。
    - name: zmk
      remote: infused-kim
      revision: pr-testing/mouse_ps2_module_base
      import: app/west.yml

    # (2) 2 回目に試す：ZMK main（pointing 統合済み）。通れば main に乗り換える。
    #     通らなければ (1) に戻す。main で使う場合、keymap 側の
    #     `behaviors/mouse_keys.dtsi` include と `zmk,input-listener-ps2` の
    #     compatible 名がエラーになる可能性が高い（README 参照）。
    # - name: zmk
    #   remote: zmkfirmware
    #   revision: main
    #   import: app/west.yml

    #
    # PS/2 Mouse & TrackPoint ドライバモジュール
    #
    - name: kb_zmk_ps2_mouse_trackpoint_driver
      remote: infused-kim
      revision: main

  self:
    path: config
```
